## boards/shields/franxx/Kconfig.defconfig
```kconfig
if SHIELD_FRANXX_LEFT

# Name must be less than 16 characters long!
config ZMK_KEYBOARD_NAME
    default "FRANXX"

config ZMK_SPLIT_ROLE_CENTRAL
    default y

endif

if SHIELD_FRANXX_LEFT || SHIELD_FRANXX_RIGHT

config ZMK_BLE_EXPERIMENTAL_CONN
    default y

config ZMK_SETTINGS_RESET_ON_START
    default y

config ZMK_POINTING
    default y

config USB_DEVICE_MANUFACTURER
    default "Owen Friedman"

config BT_DIS_MANUF
    default "Owen Friedman"

config ZMK_SPLIT
    default y

endif
```

## boards/shields/franxx/Kconfig.shield
```kconfig
# This creates two boolean config options (one for each half of the split keyboard).
# The def_bool with shields_list_contains automatically sets these to true when the corresponding shield name is specified in the build.

config SHIELD_FRANXX_LEFT
    def_bool $(shields_list_contains,franxx_left)

config SHIELD_FRANXX_RIGHT
    def_bool $(shields_list_contains,franxx_right)
```
